## conf/layer.conf
```bitbake
# We have a conf and classes directory, add to BBPATH
BBPATH .= ":${LAYERDIR}"

# We have recipes-* directories, add to BBFILES
BBFILES += "${LAYERDIR}/recipes-*/*/*.bb \
	${LAYERDIR}/recipes-*/*/*.bbappend"

# This folder should only contains specific patches to fix issue on oe recipes
# Note that these patches may be pushed on Community
BBFILES += "${LAYERDIR}/oe-core/recipes-*/*/*.bbappend"

BBFILE_COLLECTIONS += "stm-tsn-base"
BBFILE_PATTERN_stm-tsn-base = "^${LAYERDIR}/"
BBFILE_PRIORITY_stm-tsn-base = "6"
LICENSE_PATH += "${LAYERDIR}/TTTECH-license"
SPDXLICENSEMAP[Commercial] = "TTTECH_license.txt"
# Set a variable to get the meta-st-stm32mp-tsn-swch location
TSN_BASE_LAYER = "${LAYERDIR}"

# OpenSTLinux compatibility version
ST_OSTL_COMPATIBILTY_VERSION_stm-tsn-base = "6.0"

# This should only be incremented on significant changes that will
# cause compatibility issues with other layers
LAYERVERSION_stm-tsn-base = "1"
LAYERSERIES_COMPAT_stm-tsn-base = "scarthgap"

# Usage of SOURCE
TSN_SRC_URI = "git://gitolite@codex.cro.st.com/mpu/oe/tsn/tttech-tsn-content;protocol=ssh;branch=1.6.8"
TSN_SRCREV = "28c85fb3a2205766947298eddcdba8149ed37068"

# Name of default ethernet interface for bridge support
DEFAULT_ETHERNET_MAIN_TSN_BRIDGE_INTERFACE ??= "end1"
```
